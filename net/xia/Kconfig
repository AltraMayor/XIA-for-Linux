## net/xia/Kconfig
```kconfig
config XIA
	tristate "eXpressive Internet Architecture (EXPERIMENTAL)"
	default n
	help
	  eXpressive Internet Architecture (XIA) is a new network stack
	  being developed by Carnegie Mellon, Boston University, and
	  University of Wisconsin-Madison for a future Internet.
	  If you are unsure how to answer this question, answer N.

	  For information about XIA, please refer to
	  <http://www.cs.cmu.edu/~xia/>

if XIA
source "net/xia/ppal_ad/Kconfig"
source "net/xia/ppal_hid/Kconfig"
source "net/xia/ppal_uni4id/Kconfig"
source "net/xia/ppal_u4id/Kconfig"
source "net/xia/ppal_xdp/Kconfig"
endif # if XIA
```

## net/xia/ppal_ad/Kconfig
```kconfig
config XIA_PPAL_AD
	tristate "Autonomous Domain Principal (EXPERIMENTAL)"
	default m
	help
	  Autonomous Domain (AD) Principal is essential to route in XIA.
	  If you have added XIA, you likely want to add this principal
	  as well.
	  If you are unsure how to answer this question, answer M.
```

## net/xia/ppal_ether/Kconfig
```kconfig
config XIA_PPAL_ETHER
        tristate "Ethernet Principal (EXPERIMENTAL)"
        default m
        help
          Ethernet (ETHER) Principal is essential to route in XIA.
          If you have added XIA, you likely want to add this principal
          as well.
          If you are unsure how to answer this question, answer M.
```

## net/xia/ppal_hid/Kconfig
```kconfig
config XIA_PPAL_HID
	tristate "Host Principal (EXPERIMENTAL)"
	default m
	help
	  Host (HID) Principal is essential to route in XIA.
	  If you have added XIA, you likely want to add this principal
	  as well.
	  If you are unsure how to answer this question, answer M.
```

## net/xia/ppal_lpm/Kconfig
```kconfig
config XIA_PPAL_LPM
	tristate "Longest Prefix Matching Principal (EXPERIMENTAL)"
	default m
	help
	  Longest Prefix Matching (LPM) Principal provides the ability to
	  lookup identifiers according to the longest matching prefix in the
	  routing table.
	  You should only add this principal if you have added XIA and wish to
	  utilize longest prefix matching.
	  If you are unsure how to answer this question, answer M.
```

## net/xia/ppal_serval/Kconfig
```kconfig
config XIA_PPAL_SERVAL
	tristate "Serval Principal (EXPERIMENTAL)"
	default m
	help
	  Serval Principal adds service-centric networking to XIA.
	  A short, _inacurate_ description would be that Serval brings
	  TCP to XIA. See http://www.serval-arch.org/ for more
	  information.
	  If you have added XIA, you likely want to add this principal
	  to support reliable connections.
	  If you are unsure how to answer this question, answer M.
```

## net/xia/ppal_u4id/Kconfig
```kconfig
config XIA_PPAL_U4ID
	tristate "UDP/IPv4 Principal (EXPERIMENTAL)"
	select NET_UDP_TUNNEL
	default m
	help
	  UDP/IPv4 (U4ID) Principal provides the ability to encapsulate XIP
	  packets into UDP-over-IPv4 packets to tunnel them through a network.
	  You should only add this principal if you have added XIA and wish to
	  utilize IPv4 to tunnel XIP data through a network. 
	  If you are unsure how to answer this question, answer M.
```

## net/xia/ppal_u6id/Kconfig
```kconfig
config XIA_PPAL_U6ID
	tristate "UDP/IPv6 Principal (EXPERIMENTAL)"
	select NET_UDP_TUNNEL
	default m
	help
	  UDP/IPv6 (U6ID) Principal provides the ability to encapsulate XIP
	  packets into UDP-over-IPv6 packets to tunnel them through a network.
	  You should only add this principal if you have added XIA and wish to
	  utilize IPv6 to tunnel XIP data through a network. 
	  If you are unsure how to answer this question, answer M.
```

## net/xia/ppal_uni4id/Kconfig
```kconfig
config XIA_PPAL_UNI4ID
	tristate "United 4ID Principal (EXPERIMENTAL)"
	default m
	help
	  United 4ID (Uni4ID) principal brings to Linux XIA
	  compatibility with Click XIA's 4ID.
	  For principal developers, United 4ID's code showcases
	  routing redirects as a mean for principal composition since
	  United 4ID in Linux XIA is a hollow principal that only
	  delegates work to U4ID and I4ID principals.
	  If you need interoperability between Click and Linux XIA,
	  you likely want to add this principal as well.
	  If you are unsure how to answer this question, answer M.
```

## net/xia/ppal_xdp/Kconfig
```kconfig
config XIA_PPAL_XDP
	tristate "XDP Principal (EXPERIMENTAL)"
	default m
	help
	  XDP (eXpressive Datagram Protocol) principal provides
	  a UDP-like protocol through Socket API.
	  If you have added XIA, you likely want to add this principal
	  as well.
	  If you are unsure how to answer this question, answer M.
```

## net/xia/ppal_zf/Kconfig
```kconfig
config XIA_PPAL_ZF
	tristate "zFilter Principal (EXPERIMENTAL)"
	default m
	help
	  zFilter principal brings a form of multicast to XIA in which
	  routers do not keep state per multicast group, but per its links.
	  If you are unsure how to answer this question, answer M.
```
